AUTOSAR XML (schema 00045)
package /vwg/services/infotainment/positioning/positioning
  service interface Positioning  # This specification describes the Positioning service. Service ID: 0x601B Author: Olaf Schmidt (EEMF/2) Author Email: olaf.schmidt3@volkswagen.de Author: Khelil, Hassene (I/EE-541) Author Email: hassene.khelil@audi.de Change Hitory: Version 3.3.0 15.07.2020, H.Khelil: added properties "LatitudeAsInt" and "LongitudeAsInt" as Int32 (32-Bit NDS Coding)
    namespaces:
      5 x symbol props:
        NS1: symbol=vwg
        NS2: symbol=services
        NS3: symbol=infotainment
        NS4: symbol=positioning
        NS5: symbol=positioning
    events:
      data positionsEvent: type=AT_PositionsEvent
      data posMapInfoEvent: type=AT_PosMapInfoEvent  # Additional map data relative to posMapMatched
    methods:
      7 x operation, all with fire-and-forget=false:
        getPositionsElements
          arg result: type=AT_PositionsResponse, direction=OUT
        subscribePositions
          arg initialEventRequired: type=BooleanApp, direction=IN
          arg result: type=AT_PositioningSubscriptionResponse, direction=OUT
        unsubscribePositions
          arg subscriptionId: type=DT_unsubscribePositions_subscriptionId_type_App, direction=IN
          arg status: type=AT_SubscriptionStatus, direction=OUT
        subscribePositionsByKey
          arg key: type=AT_PositionsPosType, direction=IN
          arg initialEventRequired: type=BooleanApp, direction=IN
          arg result: type=AT_PositioningSubscriptionResponse, direction=OUT
        getPosMapInfoElements  # Additional map data relative to posMapMatched
          arg result: type=AT_PosMapInfoResponse, direction=OUT
        subscribePosMapInfo  # Additional map data relative to posMapMatched
          arg initialEventRequired: type=BooleanApp, direction=IN
          arg result: type=AT_PositioningSubscriptionResponse, direction=OUT
        unsubscribePosMapInfo  # Additional map data relative to posMapMatched
          arg subscriptionId: type=DT_unsubscribePosMapInfo_subscriptionId_type_App, direction=IN
          arg status: type=AT_SubscriptionStatus, direction=OUT
    optional-elements:
      result.listpositions.messageCounter
      result.listpositions.latitude
      result.listpositions.longitude
      result.listpositions.altitudeMeanSeaLevel
      result.listpositions.altitudeWGS84
      result.listpositions.headingVelocityDirection
      result.listpositions.headingYawAngle
      result.listpositions.accuracyHeadingVelocityDirection
      result.listpositions.accuracyHeadingYawAngle
      result.listpositions.speed3D
      result.listpositions.speed2D
      result.listpositions.velocityNorthDirection
      result.listpositions.velocityEastDirection
      result.listpositions.velocityUpwardDirection
      result.listpositions.accuracySpeed3D
      result.listpositions.accuracySpeed2D
      result.listpositions.accuracyHorizontal
      result.listpositions.accuracyEllipseSemiMajorAxis
      result.listpositions.accuracyEllipseSemiMajorAxisHeading
      result.listpositions.accuracyEllipseSemiMinorAxis
      result.listpositions.accuracyVertical
      result.listpositions.accuracyPitchAngle
      result.listpositions.accuracyRollAngle
      result.listpositions.pitchAngle
      result.listpositions.rollAngle
      result.listpositions.drivingDirection
      result.listpositions.statusFrontCamera
      result.listpositions.statusGNSS
      result.listpositions.statusLandmarks
      result.listpositions.statusTopView
      result.listpositions.statusLidar
      result.listpositions.statusSystem
      result.listpositions.latency
      result.listpositions.preciseLocalTimeSeconds
      result.listpositions.preciseLocalTimeNanoseconds
      result.listpositions.geodeticDatum
      result.listpositions.latitudeAsInt
      result.listpositions.longitudeAsInt
      positionsEvent.element.messageCounter
      positionsEvent.element.latitude
      positionsEvent.element.longitude
      positionsEvent.element.altitudeMeanSeaLevel
      positionsEvent.element.altitudeWGS84
      positionsEvent.element.headingVelocityDirection
      positionsEvent.element.headingYawAngle
      positionsEvent.element.accuracyHeadingVelocityDirection
      positionsEvent.element.accuracyHeadingYawAngle
      positionsEvent.element.speed3D
      positionsEvent.element.speed2D
      positionsEvent.element.velocityNorthDirection
      positionsEvent.element.velocityEastDirection
      positionsEvent.element.velocityUpwardDirection
      positionsEvent.element.accuracySpeed3D
      positionsEvent.element.accuracySpeed2D
      positionsEvent.element.accuracyHorizontal
      positionsEvent.element.accuracyEllipseSemiMajorAxis
      positionsEvent.element.accuracyEllipseSemiMajorAxisHeading
      positionsEvent.element.accuracyEllipseSemiMinorAxis
      positionsEvent.element.accuracyVertical
      positionsEvent.element.accuracyPitchAngle
      positionsEvent.element.accuracyRollAngle
      positionsEvent.element.pitchAngle
      positionsEvent.element.rollAngle
      positionsEvent.element.drivingDirection
      positionsEvent.element.statusFrontCamera
      positionsEvent.element.statusGNSS
      positionsEvent.element.statusLandmarks
      positionsEvent.element.statusTopView
      positionsEvent.element.statusLidar
      positionsEvent.element.statusSystem
      positionsEvent.element.latency
      positionsEvent.element.preciseLocalTimeSeconds
      positionsEvent.element.preciseLocalTimeNanoseconds
      positionsEvent.element.geodeticDatum
      positionsEvent.element.latitudeAsInt
      positionsEvent.element.longitudeAsInt
      result.listposMapInfo.accuracyIsLaneAccurate
      result.listposMapInfo.numberOfLanes
      result.listposMapInfo.laneNumber
      result.listposMapInfo.linkId
      result.listposMapInfo.distanceOnLink
      result.listposMapInfo.offsetOnLane
      result.listposMapInfo.laneId
      result.listposMapInfo.laneGroupId
      result.listposMapInfo.tileId
      result.listposMapInfo.updateRegionId
      result.listposMapInfo.productId
      result.listposMapInfo.distanceLeftMarking
      result.listposMapInfo.distanceRightMarking
      result.listposMapInfo.locationIsCarTrain
      result.listposMapInfo.locationIsFerry
      result.listposMapInfo.locationIsParkingStructure
      result.listposMapInfo.locationIsParkingArea
      result.listposMapInfo.offRoadStatus
      result.listposMapInfo.gradient
      result.listposMapInfo.slope
      result.listposMapInfo.trafficDirection
      result.listposMapInfo.laneType
      result.listposMapInfo.isMotorwayRoad
      result.listposMapInfo.isUrbanRoad
      result.listposMapInfo.mapMatchingSource
      result.listposMapInfo.preciseLocalTimeSeconds
      result.listposMapInfo.preciseLocalTimeNanoseconds
      result.listposMapInfo.directionOnLink
      result.listposMapInfo.floornumber
      posMapInfoEvent.element.accuracyIsLaneAccurate
      posMapInfoEvent.element.numberOfLanes
      posMapInfoEvent.element.laneNumber
      posMapInfoEvent.element.linkId
      posMapInfoEvent.element.distanceOnLink
      posMapInfoEvent.element.offsetOnLane
      posMapInfoEvent.element.laneId
      posMapInfoEvent.element.laneGroupId
      posMapInfoEvent.element.tileId
      posMapInfoEvent.element.updateRegionId
      posMapInfoEvent.element.productId
      posMapInfoEvent.element.distanceLeftMarking
      posMapInfoEvent.element.distanceRightMarking
      posMapInfoEvent.element.locationIsCarTrain
      posMapInfoEvent.element.locationIsFerry
      posMapInfoEvent.element.locationIsParkingStructure
      posMapInfoEvent.element.locationIsParkingArea
      posMapInfoEvent.element.offRoadStatus
      posMapInfoEvent.element.gradient
      posMapInfoEvent.element.slope
      posMapInfoEvent.element.trafficDirection
      posMapInfoEvent.element.laneType
      posMapInfoEvent.element.isMotorwayRoad
      posMapInfoEvent.element.isUrbanRoad
      posMapInfoEvent.element.mapMatchingSource
      posMapInfoEvent.element.preciseLocalTimeSeconds
      posMapInfoEvent.element.preciseLocalTimeNanoseconds
      posMapInfoEvent.element.directionOnLink
      posMapInfoEvent.element.floornumber
  data type mapping set PositioningDM
    data-type-maps:
      application-data-type=DT_unsubscribePositions_subscriptionId_type_App, implementation-data-type=UInt32
      application-data-type=DT_unsubscribePosMapInfo_subscriptionId_type_App, implementation-data-type=UInt32
      application-data-type=AT_PositionsResponse, implementation-data-type=PositionsResponse
      application-data-type=AT_PositioningSubscriptionResponse, implementation-data-type=PositioningSubscriptionResponse
      application-data-type=DT_PositioningSubscriptionResponse_subscriptionId_type_App, implementation-data-type=UInt32
      application-data-type=AT_SubscriptionStatus, implementation-data-type=SubscriptionStatus
      application-data-type=AT_PositionsEvent, implementation-data-type=PositionsEvent
      application-data-type=DT_PositionsEvent_subscriptionId_type_App, implementation-data-type=UInt32
      application-data-type=DT_PositionsEvent_updateCounter_type_App, implementation-data-type=UInt32
      application-data-type=DT_PositionsEvent_totalNoOfMessages_type_App, implementation-data-type=UInt16
      application-data-type=DT_PositionsEvent_eventMessageCounter_type_App, implementation-data-type=UInt16
      application-data-type=DT_PositionsEvent_noOfResourceElements_type_App, implementation-data-type=UInt16
      application-data-type=AT_PosMapInfoResponse, implementation-data-type=PosMapInfoResponse
      application-data-type=AT_PosMapInfoEvent, implementation-data-type=PosMapInfoEvent
      application-data-type=DT_PosMapInfoEvent_subscriptionId_type_App, implementation-data-type=UInt32
      application-data-type=DT_PosMapInfoEvent_updateCounter_type_App, implementation-data-type=UInt32
      application-data-type=DT_PosMapInfoEvent_totalNoOfMessages_type_App, implementation-data-type=UInt16
      application-data-type=DT_PosMapInfoEvent_eventMessageCounter_type_App, implementation-data-type=UInt16
      application-data-type=DT_PosMapInfoEvent_noOfResourceElements_type_App, implementation-data-type=UInt16
      application-data-type=AT_OperationStatus, implementation-data-type=OperationStatus
      application-data-type=AT_SubscriptionType, implementation-data-type=SubscriptionType
      application-data-type=AT_PositionsResourceType, implementation-data-type=PositionsResourceType
      application-data-type=DT_PositionsResourceType_messageCounter_type_App, implementation-data-type=UInt8
      application-data-type=DT_PositionsResourceType_latitude_type_App, implementation-data-type=Double
      application-data-type=DT_PositionsResourceType_longitude_type_App, implementation-data-type=Double
      application-data-type=DT_PositionsResourceType_altitudeMeanSeaLevel_type_App, implementation-data-type=Float
      application-data-type=DT_PositionsResourceType_altitudeWGS84_type_App, implementation-data-type=Float
      application-data-type=DT_PositionsResourceType_headingVelocityDirection_type_App, implementation-data-type=Float
      application-data-type=DT_PositionsResourceType_headingYawAngle_type_App, implementation-data-type=Float
      application-data-type=DT_PositionsResourceType_accuracyHeadingVelocityDirection_type_App, implementation-data-type=Float
      application-data-type=DT_PositionsResourceType_accuracyHeadingYawAngle_type_App, implementation-data-type=Float
      application-data-type=DT_PositionsResourceType_speed3D_type_App, implementation-data-type=Float
      application-data-type=DT_PositionsResourceType_speed2D_type_App, implementation-data-type=Float
      application-data-type=DT_PositionsResourceType_velocityNorthDirection_type_App, implementation-data-type=Float
      application-data-type=DT_PositionsResourceType_velocityEastDirection_type_App, implementation-data-type=Float
      application-data-type=DT_PositionsResourceType_velocityUpwardDirection_type_App, implementation-data-type=Float
      application-data-type=DT_PositionsResourceType_accuracySpeed3D_type_App, implementation-data-type=Float
      application-data-type=DT_PositionsResourceType_accuracySpeed2D_type_App, implementation-data-type=Float
      application-data-type=DT_PositionsResourceType_accuracyHorizontal_type_App, implementation-data-type=Float
      application-data-type=DT_PositionsResourceType_accuracyEllipseSemiMajorAxis_type_App, implementation-data-type=Float
      application-data-type=DT_PositionsResourceType_accuracyEllipseSemiMajorAxisHeading_type_App, implementation-data-type=Float
      application-data-type=DT_PositionsResourceType_accuracyEllipseSemiMinorAxis_type_App, implementation-data-type=Float
      application-data-type=DT_PositionsResourceType_accuracyVertical_type_App, implementation-data-type=Float
      application-data-type=DT_PositionsResourceType_accuracyPitchAngle_type_App, implementation-data-type=Float
      application-data-type=DT_PositionsResourceType_accuracyRollAngle_type_App, implementation-data-type=Float
      application-data-type=DT_PositionsResourceType_pitchAngle_type_App, implementation-data-type=Float
      application-data-type=DT_PositionsResourceType_rollAngle_type_App, implementation-data-type=Float
      application-data-type=DT_PositionsResourceType_latency_type_App, implementation-data-type=Int32
      application-data-type=DT_PositionsResourceType_preciseLocalTimeSeconds_type_App, implementation-data-type=UInt32
      application-data-type=DT_PositionsResourceType_preciseLocalTimeNanoseconds_type_App, implementation-data-type=UInt32
      application-data-type=DT_PositionsResourceType_latitudeAsInt_type_App, implementation-data-type=Int32
      application-data-type=DT_PositionsResourceType_longitudeAsInt_type_App, implementation-data-type=Int32
      application-data-type=AT_PositionsPosType, implementation-data-type=PositionsPosType
      application-data-type=AT_PosMapInfoResourceType, implementation-data-type=PosMapInfoResourceType
      application-data-type=DT_PosMapInfoResourceType_elementId_type_App, implementation-data-type=UInt8
      application-data-type=DT_PosMapInfoResourceType_numberOfLanes_type_App, implementation-data-type=UInt8
      application-data-type=DT_PosMapInfoResourceType_laneNumber_type_App, implementation-data-type=UInt8
      application-data-type=DT_PosMapInfoResourceType_linkId_type_App, implementation-data-type=UInt32
      application-data-type=DT_PosMapInfoResourceType_distanceOnLink_type_App, implementation-data-type=Float
      application-data-type=DT_PosMapInfoResourceType_offsetOnLane_type_App, implementation-data-type=Float
      application-data-type=DT_PosMapInfoResourceType_laneId_type_App, implementation-data-type=UInt32
      application-data-type=DT_PosMapInfoResourceType_laneGroupId_type_App, implementation-data-type=UInt32
      application-data-type=DT_PosMapInfoResourceType_tileId_type_App, implementation-data-type=UInt32
      application-data-type=DT_PosMapInfoResourceType_updateRegionId_type_App, implementation-data-type=UInt32
      application-data-type=DT_PosMapInfoResourceType_productId_type_App, implementation-data-type=UInt32
      application-data-type=DT_PosMapInfoResourceType_distanceLeftMarking_type_App, implementation-data-type=Float
      application-data-type=DT_PosMapInfoResourceType_distanceRightMarking_type_App, implementation-data-type=Float
      application-data-type=DT_PosMapInfoResourceType_slope_type_App, implementation-data-type=Float
      application-data-type=DT_PosMapInfoResourceType_preciseLocalTimeSeconds_type_App, implementation-data-type=UInt32
      application-data-type=DT_PosMapInfoResourceType_preciseLocalTimeNanoseconds_type_App, implementation-data-type=UInt32
      application-data-type=DT_PosMapInfoResourceType_floornumber_type_App, implementation-data-type=Int8
      application-data-type=AT_PositionsVector, implementation-data-type=PositionsVector
      application-data-type=AT_DrivingDirectionDefinition, implementation-data-type=DrivingDirectionDefinition
      application-data-type=AT_PositionsStatusExternSensors, implementation-data-type=PositionsStatusExternSensors
      application-data-type=AT_StatusSystemDefinition, implementation-data-type=StatusSystemDefinition
      application-data-type=AT_GeodeticDatumDefinition, implementation-data-type=GeodeticDatumDefinition
      application-data-type=AT_PosMapInfoVector, implementation-data-type=PosMapInfoVector
      application-data-type=AT_PosMapInfoOffRoadStatus, implementation-data-type=PosMapInfoOffRoadStatus
      application-data-type=AT_PosMapInfoGradient, implementation-data-type=PosMapInfoGradient
      application-data-type=AT_PosMapInfoTrafficDirection, implementation-data-type=PosMapInfoTrafficDirection
      application-data-type=AT_PosMapInfoLaneType, implementation-data-type=PosMapInfoLaneType
      application-data-type=AT_PosMapInfoMapMatchingSource, implementation-data-type=PosMapInfoMapMatchingSource
      application-data-type=AT_PosMapInfoDirectionOnLink, implementation-data-type=PosMapInfoDirectionOnLink
  port interface to data type mapping PositioningPIDM: data-type-mapping-set=PositioningDM, port-interface=Positioning
package /vwg/services/infotainment/positioning/positioning/datatypes
  app type DT_unsubscribePositions_subscriptionId_type_App: category=VALUE, range phys 0..4294967295
  app type DT_unsubscribePosMapInfo_subscriptionId_type_App: category=VALUE, range phys 0..4294967295
  application record data type AT_PositionsResponse: category=STRUCTURE
    application record element status: type=AT_OperationStatus
    application record element listpositions: type=AT_PositionsVector
  impl type PositionsResponse: category=STRUCTURE
    element status: implementation-data-type=OperationStatus
    element listpositions: implementation-data-type=PositionsVector
  implementation data type extension PositionsResponse_Ext: implementation-data-type=PositionsResponse
    namespaces:
      5 x symbol props:
        NS1: symbol=vwg
        NS2: symbol=services
        NS3: symbol=infotainment
        NS4: symbol=positioning
        NS5: symbol=positioning
  application record data type AT_PositioningSubscriptionResponse: category=STRUCTURE
    application record element subscriptionId: type=DT_PositioningSubscriptionResponse_subscriptionId_type_App
    application record element status: type=AT_SubscriptionStatus
  impl type PositioningSubscriptionResponse: category=STRUCTURE
    element subscriptionId: implementation-data-type=UInt32
    element status: implementation-data-type=SubscriptionStatus
  implementation data type extension PositioningSubscriptionResponse_Ext: implementation-data-type=PositioningSubscriptionResponse
    namespaces:
      5 x symbol props:
        NS1: symbol=vwg
        NS2: symbol=services
        NS3: symbol=infotainment
        NS4: symbol=positioning
        NS5: symbol=positioning
  app type DT_PositioningSubscriptionResponse_subscriptionId_type_App: category=VALUE, range phys 0..4294967295
  app type AT_SubscriptionStatus: category=VALUE, compu-method=CM_SubscriptionStatus, range raw 0..65535
  impl type SubscriptionStatus: compu-method=CM_SubscriptionStatus, range raw 0..65535, implementation-data-type=UInt16
  implementation data type extension SubscriptionStatus_Ext: implementation-data-type=SubscriptionStatus
    namespaces:
      5 x symbol props:
        NS1: symbol=vwg
        NS2: symbol=services
        NS3: symbol=infotainment
        NS4: symbol=positioning
        NS5: symbol=positioning
  compu method CM_SubscriptionStatus: 65534=subscription_timeout, 65535=subscription_error, 0=accepted, 1=running, 2=cancelled, 3=target_deleted
  application record data type AT_PositionsEvent: category=STRUCTURE
    8 x application record element:
      subscriptionId: type=DT_PositionsEvent_subscriptionId_type_App
      updateCounter: type=DT_PositionsEvent_updateCounter_type_App
      totalNoOfMessages: type=DT_PositionsEvent_totalNoOfMessages_type_App
      eventMessageCounter: type=DT_PositionsEvent_eventMessageCounter_type_App
      noOfResourceElements: type=DT_PositionsEvent_noOfResourceElements_type_App
      type: type=AT_SubscriptionType
      subscriptionStatus: type=AT_SubscriptionStatus
      element: type=AT_PositionsResourceType
  impl type PositionsEvent: category=STRUCTURE
    8 x element, all with category=TYPE_REFERENCE:
      subscriptionId: implementation-data-type=UInt32
      updateCounter: implementation-data-type=UInt32
      totalNoOfMessages: implementation-data-type=UInt16
      eventMessageCounter: implementation-data-type=UInt16
      noOfResourceElements: implementation-data-type=UInt16
      type: implementation-data-type=SubscriptionType
      subscriptionStatus: implementation-data-type=SubscriptionStatus
      element: implementation-data-type=PositionsResourceType
  implementation data type extension PositionsEvent_Ext: implementation-data-type=PositionsEvent
    namespaces:
      5 x symbol props:
        NS1: symbol=vwg
        NS2: symbol=services
        NS3: symbol=infotainment
        NS4: symbol=positioning
        NS5: symbol=positioning
  app type DT_PositionsEvent_subscriptionId_type_App: category=VALUE, range phys 0..4294967295
  app type DT_PositionsEvent_updateCounter_type_App: category=VALUE, range phys 0..4294967295
  app type DT_PositionsEvent_totalNoOfMessages_type_App: category=VALUE, range phys 0..65535
  app type DT_PositionsEvent_eventMessageCounter_type_App: category=VALUE, range phys 0..65535
  app type DT_PositionsEvent_noOfResourceElements_type_App: category=VALUE, range phys 0..65535
  application record data type AT_PosMapInfoResponse: category=STRUCTURE
    application record element status: type=AT_OperationStatus
    application record element listposMapInfo: type=AT_PosMapInfoVector
  impl type PosMapInfoResponse: category=STRUCTURE
    element status: implementation-data-type=OperationStatus
    element listposMapInfo: implementation-data-type=PosMapInfoVector
  implementation data type extension PosMapInfoResponse_Ext: implementation-data-type=PosMapInfoResponse
    namespaces:
      5 x symbol props:
        NS1: symbol=vwg
        NS2: symbol=services
        NS3: symbol=infotainment
        NS4: symbol=positioning
        NS5: symbol=positioning
  application record data type AT_PosMapInfoEvent: category=STRUCTURE
    8 x application record element:
      subscriptionId: type=DT_PosMapInfoEvent_subscriptionId_type_App
      updateCounter: type=DT_PosMapInfoEvent_updateCounter_type_App
      totalNoOfMessages: type=DT_PosMapInfoEvent_totalNoOfMessages_type_App
      eventMessageCounter: type=DT_PosMapInfoEvent_eventMessageCounter_type_App
      noOfResourceElements: type=DT_PosMapInfoEvent_noOfResourceElements_type_App
      type: type=AT_SubscriptionType
      subscriptionStatus: type=AT_SubscriptionStatus
      element: type=AT_PosMapInfoResourceType
  impl type PosMapInfoEvent: category=STRUCTURE
    8 x element, all with category=TYPE_REFERENCE:
      subscriptionId: implementation-data-type=UInt32
      updateCounter: implementation-data-type=UInt32
      totalNoOfMessages: implementation-data-type=UInt16
      eventMessageCounter: implementation-data-type=UInt16
      noOfResourceElements: implementation-data-type=UInt16
      type: implementation-data-type=SubscriptionType
      subscriptionStatus: implementation-data-type=SubscriptionStatus
      element: implementation-data-type=PosMapInfoResourceType
  implementation data type extension PosMapInfoEvent_Ext: implementation-data-type=PosMapInfoEvent
    namespaces:
      5 x symbol props:
        NS1: symbol=vwg
        NS2: symbol=services
        NS3: symbol=infotainment
        NS4: symbol=positioning
        NS5: symbol=positioning
  app type DT_PosMapInfoEvent_subscriptionId_type_App: category=VALUE, range phys 0..4294967295
  app type DT_PosMapInfoEvent_updateCounter_type_App: category=VALUE, range phys 0..4294967295
  app type DT_PosMapInfoEvent_totalNoOfMessages_type_App: category=VALUE, range phys 0..65535
  app type DT_PosMapInfoEvent_eventMessageCounter_type_App: category=VALUE, range phys 0..65535
  app type DT_PosMapInfoEvent_noOfResourceElements_type_App: category=VALUE, range phys 0..65535
  app type AT_OperationStatus: category=VALUE, compu-method=CM_OperationStatus, range raw 0..65535
  impl type OperationStatus: compu-method=CM_OperationStatus, range raw 0..65535, implementation-data-type=UInt16
  implementation data type extension OperationStatus_Ext: implementation-data-type=OperationStatus
    namespaces:
      5 x symbol props:
        NS1: symbol=vwg
        NS2: symbol=services
        NS3: symbol=infotainment
        NS4: symbol=positioning
        NS5: symbol=positioning
  compu method CM_OperationStatus: 65534=operation_timeout, 65535=protocol_error, 0=success, 202=accepted, 300=multiple_choice, 304=not_modified, 401=unauthorized, 403=forbidden, 404=not_found, 408=request_time_out, 409=conflict, 414=request_too_large, 429=too_many_requests, 431=request_header_fields_too_large, 451=unavailable_for_legal_reasons, 500=internal_server_error, 503=service_unavailable, 504=gateway_time_out, 511=network_authentication_required
  app type AT_SubscriptionType: category=VALUE, compu-method=CM_SubscriptionType, range raw 0..255
  impl type SubscriptionType: compu-method=CM_SubscriptionType, range raw 0..255, implementation-data-type=UInt8
  implementation data type extension SubscriptionType_Ext: implementation-data-type=SubscriptionType
    namespaces:
      5 x symbol props:
        NS1: symbol=vwg
        NS2: symbol=services
        NS3: symbol=infotainment
        NS4: symbol=positioning
        NS5: symbol=positioning
  compu method CM_SubscriptionType: 0=singleUpdate, 1=singleInitialEvent, 2=resourceFullUpdate, 3=resourceInitialEvent
  application record data type AT_PositionsResourceType: category=STRUCTURE
    39 x application record element:
      posType: type=AT_PositionsPosType  # DeadReckoning = Position resultin from fusion of the Vehicle ego-motion and GPS position DeadReckoningWithoutMMFeedback = Position resultin from fusion of the Vehicle ego-motion and GPS position without Map Matching Feedback MapMatched = position matched on the digital map, best match MapMatched2 = second candidate of position matched on the digital map (required for the volumen platform) StaticPosition = Accumulated position in standstill
      messageCounter: type=DT_PositionsResourceType_messageCounter_type_App  # Message counter to indicate the current sending cycle; +1 for each new cycle. Counter starts again at 0 after reaching maximum value. Used to identify corresponding cycles for satellite infos and gnss position data.
      latitude: type=DT_PositionsResourceType_latitude_type_App  # Latitude in degree of arc, Resolution: 0.00000001
      longitude: type=DT_PositionsResourceType_longitude_type_App  # Longitude in degree of arc, Resolution: 0.00000001
      altitudeMeanSeaLevel: type=DT_PositionsResourceType_altitudeMeanSeaLevel_type_App  # Height above mean sea level in m, Resolution: 0.01
      altitudeWGS84: type=DT_PositionsResourceType_altitudeWGS84_type_App  # Height above the WGS84 ellipsoid in m. Resolution: 0.01
      headingVelocityDirection: type=DT_PositionsResourceType_headingVelocityDirection_type_App  # Heading in velocity direction in degree of arc, Resolution: 0,1
      headingYawAngle: type=DT_PositionsResourceType_headingYawAngle_type_App  # Heading (yaw angle, direction of longitudinal axis, angle around the vertical axis of the vehicle) of the vehicle in degree of arc, Resolution: 0,1
      accuracyHeadingVelocityDirection: type=DT_PositionsResourceType_accuracyHeadingVelocityDirection_type_App  # Overall accuracy regarding the heading in velocity direction in degree of arc, Resolution: 0,1
      accuracyHeadingYawAngle: type=DT_PositionsResourceType_accuracyHeadingYawAngle_type_App  # Overall accuracy regarding the heading (yaw angle) in degree of arc, Resolution: 0,1
      speed3D: type=DT_PositionsResourceType_speed3D_type_App  # 3D-speed in m per second, Resolution: 0.01
      speed2D: type=DT_PositionsResourceType_speed2D_type_App  # Speed of position in m per second parallel to surface of GNSS-ellipsoid (WGS84-surface), Resolution: 0.01
      velocityNorthDirection: type=DT_PositionsResourceType_velocityNorthDirection_type_App  # Speed in m per second in north direction, Resolution: 0.01
      velocityEastDirection: type=DT_PositionsResourceType_velocityEastDirection_type_App  # Speed in m per second in east direction, Resolution: 0.01
      velocityUpwardDirection: type=DT_PositionsResourceType_velocityUpwardDirection_type_App  # Speed in m per second in vertical direction (upwards). Resolution: 0.01
      accuracySpeed3D: type=DT_PositionsResourceType_accuracySpeed3D_type_App  # Overall accuracy speed on the ground (3D) in m per second, Resolution: 0.01
      accuracySpeed2D: type=DT_PositionsResourceType_accuracySpeed2D_type_App  # Overall accuracy speed on the ground (parallel to WGS84-surface) in m per second, Resolution: 0.01
      accuracyHorizontal: type=DT_PositionsResourceType_accuracyHorizontal_type_App  # Overall accuracy regarding the 2D-position (horizontal) in m, Resolution: 0.001
      accuracyEllipseSemiMajorAxis: type=DT_PositionsResourceType_accuracyEllipseSemiMajorAxis_type_App  # Length of semi major axis of the horizontal error ellipse in m (for horizontal position accuracy), Resolution: 0.01
      accuracyEllipseSemiMajorAxisHeading: type=DT_PositionsResourceType_accuracyEllipseSemiMajorAxisHeading_type_App  # Heading of semi major axis of the horizontal error ellipse in degree of arc (for horizontal position accuracy), Resolution: 0,1
      accuracyEllipseSemiMinorAxis: type=DT_PositionsResourceType_accuracyEllipseSemiMinorAxis_type_App  # Length of semi minor axis of the horizontal error ellipse in m (for horizontal position accuracy), Resolution: 0.01
      accuracyVertical: type=DT_PositionsResourceType_accuracyVertical_type_App  # Overall accuracy regarding the 1D-position (vertical) in m, Resolution: 0.001
      accuracyPitchAngle: type=DT_PositionsResourceType_accuracyPitchAngle_type_App  # Overall accuracy regarding the pitch angle of the vehicle (Motion about the lateral axis) in degree of arc, Resolution: 0,1
      accuracyRollAngle: type=DT_PositionsResourceType_accuracyRollAngle_type_App  # Overall accuracy regarding the roll angle of the vehicle (Motion about the longitudinal axis) in degree of arc, Resolution: 0,1
      pitchAngle: type=DT_PositionsResourceType_pitchAngle_type_App  # Pitch angle of the vehicle (Angle about the lateral axis) in degree of arc, Resolution: 0,1
      rollAngle: type=DT_PositionsResourceType_rollAngle_type_App  # Roll angle of the vehicle (Angle about the longitudinal axis) in degree of arcoll, Resolution: 0,1
      drivingDirection: type=AT_DrivingDirectionDefinition  # Driving direction of the vehicle
      statusFrontCamera: type=AT_PositionsStatusExternSensors  # Status of front camera: used in datafusion or not used.
      statusGNSS: type=AT_PositionsStatusExternSensors  # Status of GNSS receiver: used in datafusion or not used.
      statusLandmarks: type=AT_PositionsStatusExternSensors  # Status of landmarks: used in datafusion or not used.
      statusTopView: type=AT_PositionsStatusExternSensors  # Status of top view camera: used in datafusion or not used.
      statusLidar: type=AT_PositionsStatusExternSensors  # Status of lidar: used in datafusion or not used.
      statusSystem: type=AT_StatusSystemDefinition  # System status of positioning.
      latency: type=DT_PositionsResourceType_latency_type_App  # Latency between the positioning time stamp and current distribution of the data on output interface in microseconds
      preciseLocalTimeSeconds: type=DT_PositionsResourceType_preciseLocalTimeSeconds_type_App  # Full seconds of time stamp of positioning data, time base: highly precise vehicle time (Precise Local Time, PLT), seconds since start of internal vehicle clock, Scale: 0-2^32-1
      preciseLocalTimeNanoseconds: type=DT_PositionsResourceType_preciseLocalTimeNanoseconds_type_App  # Nanoseconds of time stamp of positioning data (decimal places of full seconds), time base: highly precise vehicle time (Precise Local Time, PLT), Scale: 0-10^9-1
      geodeticDatum: type=AT_GeodeticDatumDefinition  # Coordinate System in which the positioning is being operating
      latitudeAsInt: type=DT_PositionsResourceType_latitudeAsInt_type_App  # Latitude (32-Bit NDS Coding)
      longitudeAsInt: type=DT_PositionsResourceType_longitudeAsInt_type_App  # Longitude(32-Bit NDS Coding)
  impl type PositionsResourceType: category=STRUCTURE
    39 x element, all with category=TYPE_REFERENCE:
      posType: implementation-data-type=PositionsPosType
      messageCounter: implementation-data-type=UInt8
      latitude: implementation-data-type=Double
      longitude: implementation-data-type=Double
      altitudeMeanSeaLevel: implementation-data-type=Float
      altitudeWGS84: implementation-data-type=Float
      headingVelocityDirection: implementation-data-type=Float
      headingYawAngle: implementation-data-type=Float
      accuracyHeadingVelocityDirection: implementation-data-type=Float
      accuracyHeadingYawAngle: implementation-data-type=Float
      speed3D: implementation-data-type=Float
      speed2D: implementation-data-type=Float
      velocityNorthDirection: implementation-data-type=Float
      velocityEastDirection: implementation-data-type=Float
      velocityUpwardDirection: implementation-data-type=Float
      accuracySpeed3D: implementation-data-type=Float
      accuracySpeed2D: implementation-data-type=Float
      accuracyHorizontal: implementation-data-type=Float
      accuracyEllipseSemiMajorAxis: implementation-data-type=Float
      accuracyEllipseSemiMajorAxisHeading: implementation-data-type=Float
      accuracyEllipseSemiMinorAxis: implementation-data-type=Float
      accuracyVertical: implementation-data-type=Float
      accuracyPitchAngle: implementation-data-type=Float
      accuracyRollAngle: implementation-data-type=Float
      pitchAngle: implementation-data-type=Float
      rollAngle: implementation-data-type=Float
      drivingDirection: implementation-data-type=DrivingDirectionDefinition
      statusFrontCamera: implementation-data-type=PositionsStatusExternSensors
      statusGNSS: implementation-data-type=PositionsStatusExternSensors
      statusLandmarks: implementation-data-type=PositionsStatusExternSensors
      statusTopView: implementation-data-type=PositionsStatusExternSensors
      statusLidar: implementation-data-type=PositionsStatusExternSensors
      statusSystem: implementation-data-type=StatusSystemDefinition
      latency: implementation-data-type=Int32
      preciseLocalTimeSeconds: implementation-data-type=UInt32
      preciseLocalTimeNanoseconds: implementation-data-type=UInt32
      geodeticDatum: implementation-data-type=GeodeticDatumDefinition
      latitudeAsInt: implementation-data-type=Int32
      longitudeAsInt: implementation-data-type=Int32
  implementation data type extension PositionsResourceType_Ext: implementation-data-type=PositionsResourceType
    namespaces:
      5 x symbol props:
        NS1: symbol=vwg
        NS2: symbol=services
        NS3: symbol=infotainment
        NS4: symbol=positioning
        NS5: symbol=positioning
  app type DT_PositionsResourceType_messageCounter_type_App: category=VALUE, range phys 0..99
  app type DT_PositionsResourceType_latitude_type_App: category=VALUE, range phys -90..90, sw-intended-resolution=0.00000001
  app type DT_PositionsResourceType_longitude_type_App: category=VALUE, range phys -180..180, sw-intended-resolution=0.00000001
  app type DT_PositionsResourceType_altitudeMeanSeaLevel_type_App: category=VALUE, range phys -500..9985.7, sw-intended-resolution=0.01
  app type DT_PositionsResourceType_altitudeWGS84_type_App: category=VALUE, range phys -500..9985.7, sw-intended-resolution=0.01
  app type DT_PositionsResourceType_headingVelocityDirection_type_App: category=VALUE, range phys 0..359.9, sw-intended-resolution=0.1
  app type DT_PositionsResourceType_headingYawAngle_type_App: category=VALUE, range phys 0..359.9, sw-intended-resolution=0.1
  app type DT_PositionsResourceType_accuracyHeadingVelocityDirection_type_App: category=VALUE, range phys 0..180, sw-intended-resolution=0.1
  app type DT_PositionsResourceType_accuracyHeadingYawAngle_type_App: category=VALUE, range phys 0..180, sw-intended-resolution=0.1
  app type DT_PositionsResourceType_speed3D_type_App: category=VALUE, range phys 0..163, sw-intended-resolution=0.01
  app type DT_PositionsResourceType_speed2D_type_App: category=VALUE, range phys 0..163, sw-intended-resolution=0.01
  app type DT_PositionsResourceType_velocityNorthDirection_type_App: category=VALUE, range phys -163..163, sw-intended-resolution=0.01
  app type DT_PositionsResourceType_velocityEastDirection_type_App: category=VALUE, range phys -163..163, sw-intended-resolution=0.01
  app type DT_PositionsResourceType_velocityUpwardDirection_type_App: category=VALUE, range phys -163..163, sw-intended-resolution=0.01
  app type DT_PositionsResourceType_accuracySpeed3D_type_App: category=VALUE, range phys 0..10, sw-intended-resolution=0.01
  app type DT_PositionsResourceType_accuracySpeed2D_type_App: category=VALUE, range phys 0..10, sw-intended-resolution=0.01
  app type DT_PositionsResourceType_accuracyHorizontal_type_App: category=VALUE, range phys 0..250, sw-intended-resolution=0.001
  app type DT_PositionsResourceType_accuracyEllipseSemiMajorAxis_type_App: category=VALUE, range phys 0..250, sw-intended-resolution=0.01
  app type DT_PositionsResourceType_accuracyEllipseSemiMajorAxisHeading_type_App: category=VALUE, range phys 0..359.9, sw-intended-resolution=0.1
  app type DT_PositionsResourceType_accuracyEllipseSemiMinorAxis_type_App: category=VALUE, range phys 0..250, sw-intended-resolution=0.01
  app type DT_PositionsResourceType_accuracyVertical_type_App: category=VALUE, range phys 0..250, sw-intended-resolution=0.001
  app type DT_PositionsResourceType_accuracyPitchAngle_type_App: category=VALUE, range phys 0..180, sw-intended-resolution=0.1
  app type DT_PositionsResourceType_accuracyRollAngle_type_App: category=VALUE, range phys 0..180, sw-intended-resolution=0.1
  app type DT_PositionsResourceType_pitchAngle_type_App: category=VALUE, range phys 0..359.9, sw-intended-resolution=0.1
  app type DT_PositionsResourceType_rollAngle_type_App: category=VALUE, range phys 0..359.9, sw-intended-resolution=0.1
  app type DT_PositionsResourceType_latency_type_App: category=VALUE, range phys -1048500..1048500
  app type DT_PositionsResourceType_preciseLocalTimeSeconds_type_App: category=VALUE, range phys 0..4294967295
  app type DT_PositionsResourceType_preciseLocalTimeNanoseconds_type_App: category=VALUE, range phys 0..4294967295
  app type DT_PositionsResourceType_latitudeAsInt_type_App: category=VALUE, range phys -2147483648..2147483647
  app type DT_PositionsResourceType_longitudeAsInt_type_App: category=VALUE, range phys -2147483648..2147483647
  app type AT_PositionsPosType: category=VALUE, compu-method=CM_PositionsPosType, range raw 0..255
  impl type PositionsPosType: compu-method=CM_PositionsPosType, range raw 0..255, implementation-data-type=UInt8
  implementation data type extension PositionsPosType_Ext: implementation-data-type=PositionsPosType
    namespaces:
      5 x symbol props:
        NS1: symbol=vwg
        NS2: symbol=services
        NS3: symbol=infotainment
        NS4: symbol=positioning
        NS5: symbol=positioning
  compu method CM_PositionsPosType: 1=DeadReckoning, 2=MapMatched, 3=StaticPosition, 4=MapMatched2, 5=MapMatched3, 6=DeadReckoningWithoutMMFeedback
  application record data type AT_PosMapInfoResourceType: category=STRUCTURE
    30 x application record element:
      elementId: type=DT_PosMapInfoResourceType_elementId_type_App  # Identifies the info object 1 = MapMatched; 2 = MapMatched2; 3 = MapMatched3;
      accuracyIsLaneAccurate: type=BooleanApp  # Accuracy regarding matching of the vehicle on the correct lane. 1 == true, 0 == false/init.
      numberOfLanes: type=DT_PosMapInfoResourceType_numberOfLanes_type_App  # Number of lanes on the current road. On leaving the road (e.g. off-road) the property will not be filled. Only valid if accuracyIsLaneAccurate == 1
      laneNumber: type=DT_PosMapInfoResourceType_laneNumber_type_App  # Current lane starting with 0. On leaving the road (e.g. off-road) the value 126 will be set. Counting from Curb to Middle. Only valid if accuracyIsLaneAccurate == 1
      linkId: type=DT_PosMapInfoResourceType_linkId_type_App  # Link-ID of the current position in the map database, Scale: 0..4294967295, Only valid if offRoadStatus == OnRoad
      distanceOnLink: type=DT_PosMapInfoResourceType_distanceOnLink_type_App  # Distance (in m) from link starting point up to the current position along the link geomety in driving direction of the link, Resolution: 0.01, Only valid if offRoadStatus == OnRoad
      offsetOnLane: type=DT_PosMapInfoResourceType_offsetOnLane_type_App  # Relative distance (in percent) from lane starting point up to the current position along the lane geomety in driving direction of the link, Resolution: 0.0001. Only valid if accuracyIsLaneAccurate == 1
      laneId: type=DT_PosMapInfoResourceType_laneId_type_App  # Lane-ID of the current position in the map database, Scale: 0..4294967295, Only valid if accuracyIsLaneAccurate == 1
      laneGroupId: type=DT_PosMapInfoResourceType_laneGroupId_type_App  # LaneGroup-ID of the current position in the map database, Scale: 0..4294967295, Only valid if accuracyIsLaneAccurate == 1
      tileId: type=DT_PosMapInfoResourceType_tileId_type_App  # Tile-ID of the start position of the current linkID in the map database, Scale: 0..4294967295, Only valid if offRoadStatus == OnRoad
      updateRegionId: type=DT_PosMapInfoResourceType_updateRegionId_type_App  # UpdateRegion-ID of the current position in the map database, Scale: 0..4294967295, Only valid if offRoadStatus == OnRoad
      productId: type=DT_PosMapInfoResourceType_productId_type_App  # Product-ID of the current position in the map database, Scale: 0..4294967295, Only valid if offRoadStatus == OnRoad
      distanceLeftMarking: type=DT_PosMapInfoResourceType_distanceLeftMarking_type_App  # Distance of current position to the left lane marking in m, Resolution: 0.01. Only valid for distanceLeftMarkingIsValid == 1
      distanceRightMarking: type=DT_PosMapInfoResourceType_distanceRightMarking_type_App  # Distance of current position to the right lane marking in m, Resolution: 0.01. Only valid for DistanceRightMarkingIsValid == 1
      locationIsCarTrain: type=BooleanApp  # Indicates the vehicles location. True (1) vehicle is on this location. False (0) vehicle is not on this location or init.
      locationIsFerry: type=BooleanApp  # Indicates the vehicles location. True (1) vehicle is on this location. False (0) vehicle is not on this location or init.
      locationIsParkingStructure: type=BooleanApp  # Indicates the vehicles location. True (1) vehicle is on this location. False (0) vehicle is not on this location or init.
      locationIsParkingArea: type=BooleanApp  # Indicates the vehicles location. True (1) vehicle is on this location. False (0) vehicle is not on this location or init.
      offRoadStatus: type=AT_PosMapInfoOffRoadStatus  # Indicates if the vehicle is on a digitized drivable area (OnRoad).
      gradient: type=AT_PosMapInfoGradient  # Indicates the gradient at the current position. The value "Level" indicates a gradient of 0 degree.
      slope: type=DT_PosMapInfoResourceType_slope_type_App  # Indicates the relative slope at the current position (0.5 represents a slope of 50%)., Resolution: 0.001. Only valid if offRoadStatus == OnRoad
      trafficDirection: type=AT_PosMapInfoTrafficDirection  # Indicates the traffic direction at the current position (left- or right-hand).
      laneType: type=AT_PosMapInfoLaneType  # Type of the lane at the current position.
      isMotorwayRoad: type=BooleanApp  # Indicates road category at the current position. True (1) vehicle is on this location. False (0) vehicle is not on this location or init.
      isUrbanRoad: type=BooleanApp  # Indicates road category at the current position. True (1) vehicle is on this location. False (0) vehicle is not on this location or init.
      mapMatchingSource: type=AT_PosMapInfoMapMatchingSource  # Currently used map data: used for map matching or map not used.
      preciseLocalTimeSeconds: type=DT_PosMapInfoResourceType_preciseLocalTimeSeconds_type_App  # Full seconds of time stamp of positioning data, time base: highly precise vehicle time (Precise Local Time, PLT), seconds since start of internal vehicle clock, Scale: 0-2^32-1
      preciseLocalTimeNanoseconds: type=DT_PosMapInfoResourceType_preciseLocalTimeNanoseconds_type_App  # Nanoseconds of time stamp of positioning data (decimal places of full seconds), time base: highly precise vehicle time (Precise Local Time, PLT), Scale: 0-10^9-1
      directionOnLink: type=AT_PosMapInfoDirectionOnLink  # Direction on link. Only valid if offRoadStatus == OnRoad
      floornumber: type=DT_PosMapInfoResourceType_floornumber_type_App  # Floornumber of the parking structure
  impl type PosMapInfoResourceType: category=STRUCTURE
    30 x element, all with category=TYPE_REFERENCE:
      elementId: implementation-data-type=UInt8
      accuracyIsLaneAccurate: implementation-data-type=Boolean
      numberOfLanes: implementation-data-type=UInt8
      laneNumber: implementation-data-type=UInt8
      linkId: implementation-data-type=UInt32
      distanceOnLink: implementation-data-type=Float
      offsetOnLane: implementation-data-type=Float
      laneId: implementation-data-type=UInt32
      laneGroupId: implementation-data-type=UInt32
      tileId: implementation-data-type=UInt32
      updateRegionId: implementation-data-type=UInt32
      productId: implementation-data-type=UInt32
      distanceLeftMarking: implementation-data-type=Float
      distanceRightMarking: implementation-data-type=Float
      locationIsCarTrain: implementation-data-type=Boolean
      locationIsFerry: implementation-data-type=Boolean
      locationIsParkingStructure: implementation-data-type=Boolean
      locationIsParkingArea: implementation-data-type=Boolean
      offRoadStatus: implementation-data-type=PosMapInfoOffRoadStatus
      gradient: implementation-data-type=PosMapInfoGradient
      slope: implementation-data-type=Float
      trafficDirection: implementation-data-type=PosMapInfoTrafficDirection
      laneType: implementation-data-type=PosMapInfoLaneType
      isMotorwayRoad: implementation-data-type=Boolean
      isUrbanRoad: implementation-data-type=Boolean
      mapMatchingSource: implementation-data-type=PosMapInfoMapMatchingSource
      preciseLocalTimeSeconds: implementation-data-type=UInt32
      preciseLocalTimeNanoseconds: implementation-data-type=UInt32
      directionOnLink: implementation-data-type=PosMapInfoDirectionOnLink
      floornumber: implementation-data-type=Int8
  implementation data type extension PosMapInfoResourceType_Ext: implementation-data-type=PosMapInfoResourceType
    namespaces:
      5 x symbol props:
        NS1: symbol=vwg
        NS2: symbol=services
        NS3: symbol=infotainment
        NS4: symbol=positioning
        NS5: symbol=positioning
  app type DT_PosMapInfoResourceType_elementId_type_App: category=VALUE, range phys 1..4
  app type DT_PosMapInfoResourceType_numberOfLanes_type_App: category=VALUE, range phys 0..255
  app type DT_PosMapInfoResourceType_laneNumber_type_App: category=VALUE, range phys 0..255
  app type DT_PosMapInfoResourceType_linkId_type_App: category=VALUE, range phys 0..4294967295
  app type DT_PosMapInfoResourceType_distanceOnLink_type_App: category=VALUE, range phys 0..42500000, sw-intended-resolution=0.01
  app type DT_PosMapInfoResourceType_offsetOnLane_type_App: category=VALUE, range phys 0..100, sw-intended-resolution=0.0001
  app type DT_PosMapInfoResourceType_laneId_type_App: category=VALUE, range phys 0..4294967295
  app type DT_PosMapInfoResourceType_laneGroupId_type_App: category=VALUE, range phys 0..4294967295
  app type DT_PosMapInfoResourceType_tileId_type_App: category=VALUE, range phys 0..4294967295
  app type DT_PosMapInfoResourceType_updateRegionId_type_App: category=VALUE, range phys 0..4294967295
  app type DT_PosMapInfoResourceType_productId_type_App: category=VALUE, range phys 0..4294967295
  app type DT_PosMapInfoResourceType_distanceLeftMarking_type_App: category=VALUE, range phys 0..10, sw-intended-resolution=0.01
  app type DT_PosMapInfoResourceType_distanceRightMarking_type_App: category=VALUE, range phys 0..10, sw-intended-resolution=0.01
  app type DT_PosMapInfoResourceType_slope_type_App: category=VALUE, range phys 0..1, sw-intended-resolution=0.001
  app type DT_PosMapInfoResourceType_preciseLocalTimeSeconds_type_App: category=VALUE, range phys 0..4294967295
  app type DT_PosMapInfoResourceType_preciseLocalTimeNanoseconds_type_App: category=VALUE, range phys 0..4294967295
  app type DT_PosMapInfoResourceType_floornumber_type_App: category=VALUE, range phys -100..100
  application array data type AT_PositionsVector: category=ARRAY, dynamic-array-size-profile=VSA_LINEAR
    element subElement: category=VALUE, type=AT_PositionsResourceType, array-size-handling=ALL-INDICES-SAME-ARRAY-SIZE, array-size-semantics=VARIABLE-SIZE, max-number-of-elements=6
  impl type PositionsVector: category=VECTOR
    element subElement: array-size=6, implementation-data-type=PositionsResourceType
  implementation data type extension PositionsVector_Ext: implementation-data-type=PositionsVector
    namespaces:
      5 x symbol props:
        NS1: symbol=vwg
        NS2: symbol=services
        NS3: symbol=infotainment
        NS4: symbol=positioning
        NS5: symbol=positioning
  app type AT_DrivingDirectionDefinition: category=VALUE, compu {0=Init, 1=Forward, 2=Backward, 3=Unknown, 4=Error}, range raw 0..255
  impl type DrivingDirectionDefinition: compu {0=Init, 1=Forward, 2=Backward, 3=Unknown, 4=Error}, range raw 0..255, implementation-data-type=UInt8
  implementation data type extension DrivingDirectionDefinition_Ext: implementation-data-type=DrivingDirectionDefinition
    namespaces:
      5 x symbol props:
        NS1: symbol=vwg
        NS2: symbol=services
        NS3: symbol=infotainment
        NS4: symbol=positioning
        NS5: symbol=positioning
  app type AT_PositionsStatusExternSensors: category=VALUE, compu {0=Init, 1=InUse, 2=NotUsed, 3=Error}, range raw 0..255
  impl type PositionsStatusExternSensors: compu {0=Init, 1=InUse, 2=NotUsed, 3=Error}, range raw 0..255, implementation-data-type=UInt8
  implementation data type extension PositionsStatusExternSensors_Ext: implementation-data-type=PositionsStatusExternSensors
    namespaces:
      5 x symbol props:
        NS1: symbol=vwg
        NS2: symbol=services
        NS3: symbol=infotainment
        NS4: symbol=positioning
        NS5: symbol=positioning
  app type AT_StatusSystemDefinition: category=VALUE, compu {0=Init, 1=Nominal, 2=MapInvalid, 3=NotAvailable, 4=Error}, range raw 0..255
  impl type StatusSystemDefinition: compu {0=Init, 1=Nominal, 2=MapInvalid, 3=NotAvailable, 4=Error}, range raw 0..255, implementation-data-type=UInt8
  implementation data type extension StatusSystemDefinition_Ext: implementation-data-type=StatusSystemDefinition
    namespaces:
      5 x symbol props:
        NS1: symbol=vwg
        NS2: symbol=services
        NS3: symbol=infotainment
        NS4: symbol=positioning
        NS5: symbol=positioning
  app type AT_GeodeticDatumDefinition: category=VALUE, compu {0=Init, 1=WGS84, 2=Z90, 3=GCJ02}, range raw 0..255
  impl type GeodeticDatumDefinition: compu {0=Init, 1=WGS84, 2=Z90, 3=GCJ02}, range raw 0..255, implementation-data-type=UInt8
  implementation data type extension GeodeticDatumDefinition_Ext: implementation-data-type=GeodeticDatumDefinition
    namespaces:
      5 x symbol props:
        NS1: symbol=vwg
        NS2: symbol=services
        NS3: symbol=infotainment
        NS4: symbol=positioning
        NS5: symbol=positioning
  application array data type AT_PosMapInfoVector: category=ARRAY, dynamic-array-size-profile=VSA_LINEAR
    element subElement: category=VALUE, type=AT_PosMapInfoResourceType, array-size-handling=ALL-INDICES-SAME-ARRAY-SIZE, array-size-semantics=VARIABLE-SIZE, max-number-of-elements=3
  impl type PosMapInfoVector: category=VECTOR
    element subElement: array-size=3, implementation-data-type=PosMapInfoResourceType
  implementation data type extension PosMapInfoVector_Ext: implementation-data-type=PosMapInfoVector
    namespaces:
      5 x symbol props:
        NS1: symbol=vwg
        NS2: symbol=services
        NS3: symbol=infotainment
        NS4: symbol=positioning
        NS5: symbol=positioning
  app type AT_PosMapInfoOffRoadStatus: category=VALUE, compu {0=Init, 1=OnRoad, 2=OffRoad, 3=Unknown, 7=Error}, range raw 0..255
  impl type PosMapInfoOffRoadStatus: compu {0=Init, 1=OnRoad, 2=OffRoad, 3=Unknown, 7=Error}, range raw 0..255, implementation-data-type=UInt8
  implementation data type extension PosMapInfoOffRoadStatus_Ext: implementation-data-type=PosMapInfoOffRoadStatus
    namespaces:
      5 x symbol props:
        NS1: symbol=vwg
        NS2: symbol=services
        NS3: symbol=infotainment
        NS4: symbol=positioning
        NS5: symbol=positioning
  app type AT_PosMapInfoGradient: category=VALUE, compu {0=Init, 1=Up, 2=Level, 3=Down, 4=Unkown, 7=Error}, range raw 0..255
  impl type PosMapInfoGradient: compu {0=Init, 1=Up, 2=Level, 3=Down, 4=Unkown, 7=Error}, range raw 0..255, implementation-data-type=UInt8
  implementation data type extension PosMapInfoGradient_Ext: implementation-data-type=PosMapInfoGradient
    namespaces:
      5 x symbol props:
        NS1: symbol=vwg
        NS2: symbol=services
        NS3: symbol=infotainment
        NS4: symbol=positioning
        NS5: symbol=positioning
  app type AT_PosMapInfoTrafficDirection: category=VALUE, compu-method=CM_PosMapInfoTrafficDirection, range raw 0..255
  impl type PosMapInfoTrafficDirection: compu-method=CM_PosMapInfoTrafficDirection, range raw 0..255, implementation-data-type=UInt8
  implementation data type extension PosMapInfoTrafficDirection_Ext: implementation-data-type=PosMapInfoTrafficDirection
    namespaces:
      5 x symbol props:
        NS1: symbol=vwg
        NS2: symbol=services
        NS3: symbol=infotainment
        NS4: symbol=positioning
        NS5: symbol=positioning
  compu method CM_PosMapInfoTrafficDirection: 0=Init, 1=LeftHandTraffic, 2=RightHandTraffic, 3=OffRoad, 4=Unknown, 7=Error
  app type AT_PosMapInfoLaneType: category=VALUE, compu-method=CM_PosMapInfoLaneType, range raw 0..255
  impl type PosMapInfoLaneType: compu-method=CM_PosMapInfoLaneType, range raw 0..255, implementation-data-type=UInt8
  implementation data type extension PosMapInfoLaneType_Ext: implementation-data-type=PosMapInfoLaneType
    namespaces:
      5 x symbol props:
        NS1: symbol=vwg
        NS2: symbol=services
        NS3: symbol=infotainment
        NS4: symbol=positioning
        NS5: symbol=positioning
  compu method CM_PosMapInfoLaneType: 0=Init, 1=Other, 2=Unknown, 3=Error, 4=EntryLane, 5=ExitLane, 6=DrivingLane, 7=EmergencyLane, 8=EntryAndExitLane, 9=EntryOrExitLane, 10=HOVLane
  app type AT_PosMapInfoMapMatchingSource: category=VALUE, compu {0=Init, 1=Basic, 2=SDLane, 3=HDLane, 4=NotUsed, 5=Error}, range raw 0..255
  impl type PosMapInfoMapMatchingSource: compu {0=Init, 1=Basic, 2=SDLane, 3=HDLane, 4=NotUsed, 5=Error}, range raw 0..255, implementation-data-type=UInt8
  implementation data type extension PosMapInfoMapMatchingSource_Ext: implementation-data-type=PosMapInfoMapMatchingSource
    namespaces:
      5 x symbol props:
        NS1: symbol=vwg
        NS2: symbol=services
        NS3: symbol=infotainment
        NS4: symbol=positioning
        NS5: symbol=positioning
  app type AT_PosMapInfoDirectionOnLink: category=VALUE, compu {0=init, 1=startToEnd, 2=endToStart, 3=error}, range raw 0..255
  impl type PosMapInfoDirectionOnLink: compu {0=init, 1=startToEnd, 2=endToStart, 3=error}, range raw 0..255, implementation-data-type=UInt8
  implementation data type extension PosMapInfoDirectionOnLink_Ext: implementation-data-type=PosMapInfoDirectionOnLink
    namespaces:
      5 x symbol props:
        NS1: symbol=vwg
        NS2: symbol=services
        NS3: symbol=infotainment
        NS4: symbol=positioning
        NS5: symbol=positioning
package /vwg/services/infotainment/positioning/positioning/deployment/serviceinterface
  someip service interface deployment Positioning_someip: service-interface=Positioning, service-interface-id=24603, service-interface-version={major-version=3, minor-version=3}
    someip event deployment positionsEvent_Event: event=positionsEvent, event-id=49280, transport-protocol=UDP
    someip event deployment posMapInfoEvent_Event: event=posMapInfoEvent, event-id=49536, transport-protocol=UDP
    7 x someip method deployment, all with transport-protocol=UDP:
      getPositionsElements: method=getPositionsElements, method-id=16391
      subscribePositions: method=subscribePositions, method-id=16400
      unsubscribePositions: method=unsubscribePositions, method-id=16402
      subscribePositionsByKey: method=subscribePositionsByKey, method-id=16399
      getPosMapInfoElements: method=getPosMapInfoElements, method-id=16647
      subscribePosMapInfo: method=subscribePosMapInfo, method-id=16656
      unsubscribePosMapInfo: method=unsubscribePosMapInfo, method-id=16658
    someip event group positionsEvent_EventGroup: event-group-id=49280, event=positionsEvent_Event
    someip event group posMapInfoEvent_EventGroup: event-group-id=49536, event=posMapInfoEvent_Event
package /vwg/services/infotainment/positioning/positioning/deployment/tlv
  transformation props to service interface element mapping set tlv_Positioning_mapping_set
    9 x transformation props to service interface element mapping:
      tlv_Positioning_getPositionsElements_method_mapping: method=getPositionsElements, transformation-props=getPositionsElements_transformation_props
        tlv-data-ids:
          id=0, tlv-argument=getPositionsElements/result
          id=0, tlv-app-record-element-in-method=result.status
          id=1, tlv-app-record-element-in-method=result.listpositions
          id=0, tlv-app-record-element-in-method=result.listpositions.posType
          id=1, tlv-app-record-element-in-method=result.listpositions.messageCounter
          id=2, tlv-app-record-element-in-method=result.listpositions.latitude
          id=3, tlv-app-record-element-in-method=result.listpositions.longitude
          id=4, tlv-app-record-element-in-method=result.listpositions.altitudeMeanSeaLevel
          id=5, tlv-app-record-element-in-method=result.listpositions.altitudeWGS84
          id=6, tlv-app-record-element-in-method=result.listpositions.headingVelocityDirection
          id=7, tlv-app-record-element-in-method=result.listpositions.headingYawAngle
          id=8, tlv-app-record-element-in-method=result.listpositions.accuracyHeadingVelocityDirection
          id=9, tlv-app-record-element-in-method=result.listpositions.accuracyHeadingYawAngle
          id=10, tlv-app-record-element-in-method=result.listpositions.speed3D
          id=11, tlv-app-record-element-in-method=result.listpositions.speed2D
          id=12, tlv-app-record-element-in-method=result.listpositions.velocityNorthDirection
          id=13, tlv-app-record-element-in-method=result.listpositions.velocityEastDirection
          id=14, tlv-app-record-element-in-method=result.listpositions.velocityUpwardDirection
          id=15, tlv-app-record-element-in-method=result.listpositions.accuracySpeed3D
          id=16, tlv-app-record-element-in-method=result.listpositions.accuracySpeed2D
          id=17, tlv-app-record-element-in-method=result.listpositions.accuracyHorizontal
          id=18, tlv-app-record-element-in-method=result.listpositions.accuracyEllipseSemiMajorAxis
          id=19, tlv-app-record-element-in-method=result.listpositions.accuracyEllipseSemiMajorAxisHeading
          id=20, tlv-app-record-element-in-method=result.listpositions.accuracyEllipseSemiMinorAxis
          id=21, tlv-app-record-element-in-method=result.listpositions.accuracyVertical
          id=22, tlv-app-record-element-in-method=result.listpositions.accuracyPitchAngle
          id=23, tlv-app-record-element-in-method=result.listpositions.accuracyRollAngle
          id=24, tlv-app-record-element-in-method=result.listpositions.pitchAngle
          id=25, tlv-app-record-element-in-method=result.listpositions.rollAngle
          id=26, tlv-app-record-element-in-method=result.listpositions.drivingDirection
          id=27, tlv-app-record-element-in-method=result.listpositions.statusFrontCamera
          id=28, tlv-app-record-element-in-method=result.listpositions.statusGNSS
          id=29, tlv-app-record-element-in-method=result.listpositions.statusLandmarks
          id=30, tlv-app-record-element-in-method=result.listpositions.statusTopView
          id=31, tlv-app-record-element-in-method=result.listpositions.statusLidar
          id=32, tlv-app-record-element-in-method=result.listpositions.statusSystem
          id=33, tlv-app-record-element-in-method=result.listpositions.latency
          id=34, tlv-app-record-element-in-method=result.listpositions.preciseLocalTimeSeconds
          id=35, tlv-app-record-element-in-method=result.listpositions.preciseLocalTimeNanoseconds
          id=36, tlv-app-record-element-in-method=result.listpositions.geodeticDatum
          id=37, tlv-app-record-element-in-method=result.listpositions.latitudeAsInt
          id=38, tlv-app-record-element-in-method=result.listpositions.longitudeAsInt
      tlv_Positioning_subscribePositions_method_mapping: method=subscribePositions, transformation-props=subscribePositions_transformation_props
        tlv-data-ids:
          id=0, tlv-argument=subscribePositions/initialEventRequired
          id=0, tlv-argument=subscribePositions/result
          id=0, tlv-app-record-element-in-method=result.subscriptionId
          id=1, tlv-app-record-element-in-method=result.status
      tlv_Positioning_unsubscribePositions_method_mapping: method=unsubscribePositions, transformation-props=unsubscribePositions_transformation_props
        tlv-data-ids:
          id=0, tlv-argument=unsubscribePositions/subscriptionId
          id=0, tlv-argument=unsubscribePositions/status
      tlv_Positioning_positionsEvent_event_mapping: event=positionsEvent, transformation-props=positionsEvent_transformation_props
        tlv-data-ids:
          id=0, tlv-app-record-element-in-service-interface=positionsEvent.subscriptionId
          id=1, tlv-app-record-element-in-service-interface=positionsEvent.updateCounter
          id=2, tlv-app-record-element-in-service-interface=positionsEvent.totalNoOfMessages
          id=3, tlv-app-record-element-in-service-interface=positionsEvent.eventMessageCounter
          id=4, tlv-app-record-element-in-service-interface=positionsEvent.noOfResourceElements
          id=5, tlv-app-record-element-in-service-interface=positionsEvent.type
          id=6, tlv-app-record-element-in-service-interface=positionsEvent.subscriptionStatus
          id=7, tlv-app-record-element-in-service-interface=positionsEvent.element
          id=0, tlv-app-record-element-in-service-interface=positionsEvent.element.posType
          id=1, tlv-app-record-element-in-service-interface=positionsEvent.element.messageCounter
          id=2, tlv-app-record-element-in-service-interface=positionsEvent.element.latitude
          id=3, tlv-app-record-element-in-service-interface=positionsEvent.element.longitude
          id=4, tlv-app-record-element-in-service-interface=positionsEvent.element.altitudeMeanSeaLevel
          id=5, tlv-app-record-element-in-service-interface=positionsEvent.element.altitudeWGS84
          id=6, tlv-app-record-element-in-service-interface=positionsEvent.element.headingVelocityDirection
          id=7, tlv-app-record-element-in-service-interface=positionsEvent.element.headingYawAngle
          id=8, tlv-app-record-element-in-service-interface=positionsEvent.element.accuracyHeadingVelocityDirection
          id=9, tlv-app-record-element-in-service-interface=positionsEvent.element.accuracyHeadingYawAngle
          id=10, tlv-app-record-element-in-service-interface=positionsEvent.element.speed3D
          id=11, tlv-app-record-element-in-service-interface=positionsEvent.element.speed2D
          id=12, tlv-app-record-element-in-service-interface=positionsEvent.element.velocityNorthDirection
          id=13, tlv-app-record-element-in-service-interface=positionsEvent.element.velocityEastDirection
          id=14, tlv-app-record-element-in-service-interface=positionsEvent.element.velocityUpwardDirection
          id=15, tlv-app-record-element-in-service-interface=positionsEvent.element.accuracySpeed3D
          id=16, tlv-app-record-element-in-service-interface=positionsEvent.element.accuracySpeed2D
          id=17, tlv-app-record-element-in-service-interface=positionsEvent.element.accuracyHorizontal
          id=18, tlv-app-record-element-in-service-interface=positionsEvent.element.accuracyEllipseSemiMajorAxis
          id=19, tlv-app-record-element-in-service-interface=positionsEvent.element.accuracyEllipseSemiMajorAxisHeading
          id=20, tlv-app-record-element-in-service-interface=positionsEvent.element.accuracyEllipseSemiMinorAxis
          id=21, tlv-app-record-element-in-service-interface=positionsEvent.element.accuracyVertical
          id=22, tlv-app-record-element-in-service-interface=positionsEvent.element.accuracyPitchAngle
          id=23, tlv-app-record-element-in-service-interface=positionsEvent.element.accuracyRollAngle
          id=24, tlv-app-record-element-in-service-interface=positionsEvent.element.pitchAngle
          id=25, tlv-app-record-element-in-service-interface=positionsEvent.element.rollAngle
          id=26, tlv-app-record-element-in-service-interface=positionsEvent.element.drivingDirection
          id=27, tlv-app-record-element-in-service-interface=positionsEvent.element.statusFrontCamera
          id=28, tlv-app-record-element-in-service-interface=positionsEvent.element.statusGNSS
          id=29, tlv-app-record-element-in-service-interface=positionsEvent.element.statusLandmarks
          id=30, tlv-app-record-element-in-service-interface=positionsEvent.element.statusTopView
          id=31, tlv-app-record-element-in-service-interface=positionsEvent.element.statusLidar
          id=32, tlv-app-record-element-in-service-interface=positionsEvent.element.statusSystem
          id=33, tlv-app-record-element-in-service-interface=positionsEvent.element.latency
          id=34, tlv-app-record-element-in-service-interface=positionsEvent.element.preciseLocalTimeSeconds
          id=35, tlv-app-record-element-in-service-interface=positionsEvent.element.preciseLocalTimeNanoseconds
          id=36, tlv-app-record-element-in-service-interface=positionsEvent.element.geodeticDatum
          id=37, tlv-app-record-element-in-service-interface=positionsEvent.element.latitudeAsInt
          id=38, tlv-app-record-element-in-service-interface=positionsEvent.element.longitudeAsInt
      tlv_Positioning_subscribePositionsByKey_method_mapping: method=subscribePositionsByKey, transformation-props=subscribePositionsByKey_transformation_props
        tlv-data-ids:
          id=0, tlv-argument=key
          id=1, tlv-argument=subscribePositionsByKey/initialEventRequired
          id=0, tlv-argument=subscribePositionsByKey/result
          id=0, tlv-app-record-element-in-method=result.subscriptionId
          id=1, tlv-app-record-element-in-method=result.status
      tlv_Positioning_getPosMapInfoElements_method_mapping: method=getPosMapInfoElements, transformation-props=getPosMapInfoElements_transformation_props
        tlv-data-ids:
          id=0, tlv-argument=getPosMapInfoElements/result
          id=0, tlv-app-record-element-in-method=result.status
          id=1, tlv-app-record-element-in-method=result.listposMapInfo
          id=0, tlv-app-record-element-in-method=result.listposMapInfo.elementId
          id=1, tlv-app-record-element-in-method=result.listposMapInfo.accuracyIsLaneAccurate
          id=2, tlv-app-record-element-in-method=result.listposMapInfo.numberOfLanes
          id=3, tlv-app-record-element-in-method=result.listposMapInfo.laneNumber
          id=4, tlv-app-record-element-in-method=result.listposMapInfo.linkId
          id=5, tlv-app-record-element-in-method=result.listposMapInfo.distanceOnLink
          id=6, tlv-app-record-element-in-method=result.listposMapInfo.offsetOnLane
          id=7, tlv-app-record-element-in-method=result.listposMapInfo.laneId
          id=8, tlv-app-record-element-in-method=result.listposMapInfo.laneGroupId
          id=9, tlv-app-record-element-in-method=result.listposMapInfo.tileId
          id=10, tlv-app-record-element-in-method=result.listposMapInfo.updateRegionId
          id=11, tlv-app-record-element-in-method=result.listposMapInfo.productId
          id=12, tlv-app-record-element-in-method=result.listposMapInfo.distanceLeftMarking
          id=13, tlv-app-record-element-in-method=result.listposMapInfo.distanceRightMarking
          id=14, tlv-app-record-element-in-method=result.listposMapInfo.locationIsCarTrain
          id=15, tlv-app-record-element-in-method=result.listposMapInfo.locationIsFerry
          id=16, tlv-app-record-element-in-method=result.listposMapInfo.locationIsParkingStructure
          id=17, tlv-app-record-element-in-method=result.listposMapInfo.locationIsParkingArea
          id=18, tlv-app-record-element-in-method=result.listposMapInfo.offRoadStatus
          id=19, tlv-app-record-element-in-method=result.listposMapInfo.gradient
          id=20, tlv-app-record-element-in-method=result.listposMapInfo.slope
          id=21, tlv-app-record-element-in-method=result.listposMapInfo.trafficDirection
          id=22, tlv-app-record-element-in-method=result.listposMapInfo.laneType
          id=23, tlv-app-record-element-in-method=result.listposMapInfo.isMotorwayRoad
          id=24, tlv-app-record-element-in-method=result.listposMapInfo.isUrbanRoad
          id=25, tlv-app-record-element-in-method=result.listposMapInfo.mapMatchingSource
          id=26, tlv-app-record-element-in-method=result.listposMapInfo.preciseLocalTimeSeconds
          id=27, tlv-app-record-element-in-method=result.listposMapInfo.preciseLocalTimeNanoseconds
          id=28, tlv-app-record-element-in-method=result.listposMapInfo.directionOnLink
          id=29, tlv-app-record-element-in-method=result.listposMapInfo.floornumber
      tlv_Positioning_subscribePosMapInfo_method_mapping: method=subscribePosMapInfo, transformation-props=subscribePosMapInfo_transformation_props
        tlv-data-ids:
          id=0, tlv-argument=subscribePosMapInfo/initialEventRequired
          id=0, tlv-argument=subscribePosMapInfo/result
          id=0, tlv-app-record-element-in-method=result.subscriptionId
          id=1, tlv-app-record-element-in-method=result.status
      tlv_Positioning_unsubscribePosMapInfo_method_mapping: method=unsubscribePosMapInfo, transformation-props=unsubscribePosMapInfo_transformation_props
        tlv-data-ids:
          id=0, tlv-argument=unsubscribePosMapInfo/subscriptionId
          id=0, tlv-argument=unsubscribePosMapInfo/status
      tlv_Positioning_posMapInfoEvent_event_mapping: event=posMapInfoEvent, transformation-props=posMapInfoEvent_transformation_props
        tlv-data-ids:
          id=0, tlv-app-record-element-in-service-interface=posMapInfoEvent.subscriptionId
          id=1, tlv-app-record-element-in-service-interface=posMapInfoEvent.updateCounter
          id=2, tlv-app-record-element-in-service-interface=posMapInfoEvent.totalNoOfMessages
          id=3, tlv-app-record-element-in-service-interface=posMapInfoEvent.eventMessageCounter
          id=4, tlv-app-record-element-in-service-interface=posMapInfoEvent.noOfResourceElements
          id=5, tlv-app-record-element-in-service-interface=posMapInfoEvent.type
          id=6, tlv-app-record-element-in-service-interface=posMapInfoEvent.subscriptionStatus
          id=7, tlv-app-record-element-in-service-interface=posMapInfoEvent.element
          id=0, tlv-app-record-element-in-service-interface=posMapInfoEvent.element.elementId
          id=1, tlv-app-record-element-in-service-interface=posMapInfoEvent.element.accuracyIsLaneAccurate
          id=2, tlv-app-record-element-in-service-interface=posMapInfoEvent.element.numberOfLanes
          id=3, tlv-app-record-element-in-service-interface=posMapInfoEvent.element.laneNumber
          id=4, tlv-app-record-element-in-service-interface=posMapInfoEvent.element.linkId
          id=5, tlv-app-record-element-in-service-interface=posMapInfoEvent.element.distanceOnLink
          id=6, tlv-app-record-element-in-service-interface=posMapInfoEvent.element.offsetOnLane
          id=7, tlv-app-record-element-in-service-interface=posMapInfoEvent.element.laneId
          id=8, tlv-app-record-element-in-service-interface=posMapInfoEvent.element.laneGroupId
          id=9, tlv-app-record-element-in-service-interface=posMapInfoEvent.element.tileId
          id=10, tlv-app-record-element-in-service-interface=posMapInfoEvent.element.updateRegionId
          id=11, tlv-app-record-element-in-service-interface=posMapInfoEvent.element.productId
          id=12, tlv-app-record-element-in-service-interface=posMapInfoEvent.element.distanceLeftMarking
          id=13, tlv-app-record-element-in-service-interface=posMapInfoEvent.element.distanceRightMarking
          id=14, tlv-app-record-element-in-service-interface=posMapInfoEvent.element.locationIsCarTrain
          id=15, tlv-app-record-element-in-service-interface=posMapInfoEvent.element.locationIsFerry
          id=16, tlv-app-record-element-in-service-interface=posMapInfoEvent.element.locationIsParkingStructure
          id=17, tlv-app-record-element-in-service-interface=posMapInfoEvent.element.locationIsParkingArea
          id=18, tlv-app-record-element-in-service-interface=posMapInfoEvent.element.offRoadStatus
          id=19, tlv-app-record-element-in-service-interface=posMapInfoEvent.element.gradient
          id=20, tlv-app-record-element-in-service-interface=posMapInfoEvent.element.slope
          id=21, tlv-app-record-element-in-service-interface=posMapInfoEvent.element.trafficDirection
          id=22, tlv-app-record-element-in-service-interface=posMapInfoEvent.element.laneType
          id=23, tlv-app-record-element-in-service-interface=posMapInfoEvent.element.isMotorwayRoad
          id=24, tlv-app-record-element-in-service-interface=posMapInfoEvent.element.isUrbanRoad
          id=25, tlv-app-record-element-in-service-interface=posMapInfoEvent.element.mapMatchingSource
          id=26, tlv-app-record-element-in-service-interface=posMapInfoEvent.element.preciseLocalTimeSeconds
          id=27, tlv-app-record-element-in-service-interface=posMapInfoEvent.element.preciseLocalTimeNanoseconds
          id=28, tlv-app-record-element-in-service-interface=posMapInfoEvent.element.directionOnLink
          id=29, tlv-app-record-element-in-service-interface=posMapInfoEvent.element.floornumber
  transformation props set Positioning_transformation_props_set
    9 x ap someip transformation props, all with byte-order=big-endian, size-of-array-length-field=2, size-of-string-length-field=2, size-of-struct-length-field=2:
      getPositionsElements_transformation_props
      subscribePositions_transformation_props
      unsubscribePositions_transformation_props
      positionsEvent_transformation_props
      subscribePositionsByKey_transformation_props
      getPosMapInfoElements_transformation_props
      subscribePosMapInfo_transformation_props
      unsubscribePosMapInfo_transformation_props
      posMapInfoEvent_transformation_props
